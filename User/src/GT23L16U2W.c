#include "includes.h"

unsigned int  ZFTABLE[1088]={ 
0xa1,0xa2,0xa3,0xa4,0xa5,0xa6,0xa7,0xa8, 
0xa9,0xaa,0xab,0xac,0xad,0xae,0xaf,0xb0, 
0xb1,0xb2,0xb3,0xb4,0xb5,0xb6,0xb7,0xb8, 
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0xff5d,0xff5e,0xffe0,0xffe1,0xffe2,0xffe3,0xffe4,0xffe5 
};

void GT32_Init(void)
{
    GPIO_InitTypeDef GPIO_InitStructure;
    //开启相应的时钟
	/* LD1 & LD2 & LD3 & LD4 configration */	
	GPIO_InitStructure.GPIO_Pin = GPIO_Pin_15 | GPIO_Pin_12 | GPIO_Pin_13;	
	GPIO_InitStructure.GPIO_Mode = GPIO_Mode_Out_PP;
	GPIO_InitStructure.GPIO_Speed = GPIO_Speed_50MHz;
	GPIO_Init(GPIOB, &GPIO_InitStructure);
	
	/* 按键引脚配置 */	
	GPIO_InitStructure.GPIO_Pin = GPIO_Pin_14 ;	
	GPIO_InitStructure.GPIO_Mode = GPIO_Mode_IPU;
	GPIO_InitStructure.GPIO_Speed = GPIO_Speed_50MHz;
	GPIO_Init(GPIOB, &GPIO_InitStructure); 
}

boolean GT32_Test(void)
{
	u8t i=0;
	u16t ucode=0x662F;
	u8t testLattice[32]={0x1F,0xF0,0x10,0x10,0x10,0x10,0x1f,0xf0,0x10,0x10,0x10,0x10,0x1f,0xf0,0x00,0x00,0xff,0xfe,0x01,0x00,0x11,0x00,0x11,0xf8,0x11,0x00,0x29,0x00,0x45,0x00,0x83,0xfe};
	u8t tmpLattice[32];
	memset(tmpLattice,0,sizeof(tmpLattice));
	Char2Lattice(ucode, tmpLattice, FONT_SIZE_15X16);
	for(i=0;i<FONT_15X16_LENGTH;i++)
	{
		if(testLattice[i]!=tmpLattice[i])
		{
			return DEF_FALSE;
		}
	}
	return DEF_TRUE;
}
u8t GT32_WirteByte(u8t bytes)
{
	u8t i;
	//u8t temp;
	Clr_GTSCK;
//	for(temp=0;temp<20;temp++);            //不能太快
	for(i=0;i<8;i++)
	{

		if(0x80 == (bytes & 0x80))
		{
			Set_GTMOSI;
		}
		else
		{
			Clr_GTMOSI;
		}
		bytes = (bytes<<1);
		Set_GTSCK;
	//	for(temp=0;temp<20;temp++);			   //使用模式SPI时间的延时要把握好，不能太短	   

		if(GPIO_ReadInputDataBit(GPIOB, GPIO_Pin_14) !=0)
			bytes |=1;
		else
			bytes&=~1;

		Clr_GTSCK;
	//	for(temp=0;temp<20;temp++);            //不能太快

	}
	return (bytes);
}

void Char2Lattice(u16t ucode,u8t *latticeArray,u16t fontSize)
{
	u8t i;
	u8t latticeLength;
	u32t fontAddress;
	switch(fontSize)
	{
		case FONT_SIZE_11X12:
			latticeLength=FONT_11X12_LENGTH;
			fontAddress=GetFont11X12Address(ucode);
			break;
		case FONT_SIZE_15X16:
			latticeLength=FONT_15X16_LENGTH;
			fontAddress=GetFont15X16Address(ucode);		
			break;
		case FONT_SIZE_7X8_ASCII:
			latticeLength=FONT_7X8_LENGTH;
			fontAddress=GetFont7X8AsciiAddress(ucode);			
			break;
		case FONT_SIZE_8X16_ASCII:
			latticeLength=FONT_8X16_LENGTH;
			fontAddress=GetFont8X16AsciiAddress(ucode);			
			break;
		default:
			break;
	}
		
  	Clr_GTCE;                    
	GT32_WirteByte(0x03);     
  	GT32_WirteByte((u8t)(fontAddress>>16));           
	GT32_WirteByte((u8t)(fontAddress>>8));
	GT32_WirteByte((u8t)fontAddress);
	for(i=0;i<latticeLength;i++)
	{
		latticeArray[i]=GT32_WirteByte(0xff);
  	}
  	Set_GTCE; 	
}

u32t GetFont11X12Address(u16t ucode)
{
	u32t baseAdd=FONT_11X12_BASE;
	u32t address=0;
	u16t i=0;
	if(ucode>=0x3400&&ucode<=0x4DB5)
		address=(ucode-0x3400)*24+baseAdd;
	else if(ucode>=0x4E00&&ucode<=0x9FA5)
		address=(ucode-0x4E00+6582)*24+baseAdd;
	else if((ucode>=0xFF00&&ucode<=0xFF5E)||(ucode>=0x20&&ucode<=0x7e))
	{
		if(ucode==0xFF00||ucode==0x20)
			address=(27484+538)*24+baseAdd;
		else if(ucode>0xFF00&&ucode<=0xFF5E)
			address=(ucode-0xFF00+27484+987)*24+baseAdd;
		else if(ucode>0x20&&ucode<=0x7e)
			address=(ucode-0x20+27494+987)*24+baseAdd;
	}
	else if((ucode>=0x00A1&&ucode<=0x33D5)||(ucode>=0xE76C&&ucode<=0xFFE5))
	{
		for(i=0;i<1088;i++)
		{
			if(ucode==ZFTABLE[i])
				break;
		}
		address=i*24+27484*24+baseAdd;
	}
	return address;
}

u32t GetFont15X16Address(u16t ucode)
{
	u32t baseAdd=FONT_15X16_BASE;
	u32t address=0;
	u16t i=0;
	if(ucode>=0x3400&&ucode<=0x4DB5)
		address=(ucode-0x3400)*32+baseAdd;
	else if(ucode>=0x4E00&&ucode<=0x9FA5)
		address=(ucode-0x4E00+6582)*32+baseAdd;
	else if((ucode>=0xFF00&&ucode<=0xFF5E)||(ucode>=0x20&&ucode<=0x7e))
	{
		if(ucode==0xFF00||ucode==0x20)
			address=(27484+538)*32+baseAdd;
		else if(ucode>0xFF00&&ucode<=0xFF5E)
			address=(ucode-0xFF00+27484+987)*32+baseAdd;
		else if(ucode>0x20&&ucode<=0x7e)
			address=(ucode-0x20+27494+987)*32+baseAdd;
	}
	else if((ucode>=0x00A1&&ucode<=0x33D5)||(ucode>=0xE76C&&ucode<=0xFFE5))
	{
		for(i=0;i<1088;i++)
		{
			if(ucode==ZFTABLE[i])
				break;
		}
		address=i*32+27484*32+baseAdd;
	}
	return address;
}

u32t GetFont7X8AsciiAddress(u16t ucode)
{
	u32t baseAdd=FONT_7X8_ASCII_BASE;
	u32t address=0;
	if((ucode>=0x20)&&(ucode<=0x7e))
		address=(ucode-0x20)*8+baseAdd;
	return address;
}

u32t GetFont8X16AsciiAddress(u16t ucode)
{
	u32t baseAdd=FONT_8X16_ASCII_BASE;
	u32t address=0;
	if((ucode>=0x20)&&(ucode<=0x7e))
		address=(ucode-0x20)*16+baseAdd;
	return address;	
}