/****************************************Copyright (c)****************************************************
**                            shanghai aian electronics Co.,LTD.
**                                 上海艾安电子有限公司
**                                 http://www.sh2a.com
**                                     秋叶工作室
**------File Info-----------------------------------------------------------------------------------------
** File name:               main.c
** Latest modified Date:    2011-7-18
** Latest Version:          1.0
** Descriptions:            LED显示屏驱动卡，扫描方式1/4，接口为12接口，点阵16*128。使用字库芯片，DS1302存
**                          储芯片等。RS485通信方式              
**--------------------------------------------------------------------------------------------------------
** Created by:              李正星
** Created date:            2011-07-18
** Version:                 1.0
** Descriptions:            
**
**--------------------------------------------------------------------------------------------------------
** Modified by:
** Modified date:
** Version:
** Descriptions:
**
*********************************************************************************************************/

/*********************************************************************************************************
硬件寄存器相关操作头文件
*********************************************************************************************************/

#include "includes.h"
/*********************************************************************************************************
** 函数名称: RCC_Configuration
** 功能描述: 打开系统可以使用到模块以及相应的功能。
** 输  　入: 无。
** 输　  出: 无
** 全局变量: 无
** 调用模块: 无
** 返    回：无
** 作  　者: 李正星
** 日　  期: 2011年7月18日
**------------------------------------------------------------------------------------------------------
** 修 改 人:
** 日　  期:
**------------------------------------------------------------------------------------------------------
*********************************************************************************************************/
void RCC_Configuration(void)
{
    RCC_APB2PeriphClockCmd(RCC_APB2Periph_USART1 |
                           RCC_APB2Periph_GPIOA  |RCC_APB2Periph_GPIOB  |RCC_APB2Periph_GPIOC  |
                           RCC_APB2Periph_GPIOD  |RCC_APB2Periph_GPIOE  , ENABLE);
    RCC_APB1PeriphClockCmd(RCC_APB1Periph_USART2| RCC_APB1Periph_TIM3, ENABLE);
}

/*********************************************************************************************************
** 函数名称: GPIO_Configuration
** 功能描述: 配置驱动所需要的GPIO口。
** 输  　入: 无。
** 输　  出: 无
** 全局变量: 无
** 调用模块: 无
** 返    回：无
** 作  　者: 李正星
** 日　  期: 2011年7月18日
**------------------------------------------------------------------------------------------------------
** 修 改 人:
** 日　  期:
**------------------------------------------------------------------------------------------------------
*********************************************************************************************************/
void GPIO_Configuration(void)
{
        UART_Init();         //串口配置
        LedInit();		     //LED屏驱动
}
/*********************************************************************************************************
** 函数名称: NVIC_Configuration
** 功能描述: 整个程序的中断配置函数。
** 输  　入: 无。
** 输　  出: 无
** 全局变量: 无
** 调用模块: 无
** 返    回：无
** 作  　者: 李正星
** 日　  期: 2011年7月18日
**------------------------------------------------------------------------------------------------------
** 修 改 人:
** 日　  期:
**------------------------------------------------------------------------------------------------------
*********************************************************************************************************/
void NVIC_Configuration(void)
{
    //UART_INT_Configuration();//串口中断
}   
/*********************************************************************************************************
** 函数名称: SysClock_Init
** 功能描述: 系统时钟配置，12M晶振 PLL使用6倍频。。
** 输  　入: 无。
** 输　  出: 无
** 全局变量: 无
** 调用模块: 无
** 返    回：无
** 作  　者: 李正星
** 日　  期: 2011年7月18日
**------------------------------------------------------------------------------------------------------
** 修 改 人:
** 日　  期:
**------------------------------------------------------------------------------------------------------
*********************************************************************************************************/
void SysClock_Init(void)
{
    ErrorStatus HSEStartUpStatus;
    RCC_DeInit();
    RCC_HSEConfig(RCC_HSE_ON);
    HSEStartUpStatus = RCC_WaitForHSEStartUp();
    if(HSEStartUpStatus == SUCCESS)
    {
        FLASH_PrefetchBufferCmd(FLASH_PrefetchBuffer_Enable);
        FLASH_SetLatency(FLASH_Latency_2);
        RCC_HCLKConfig(RCC_SYSCLK_Div1);
        RCC_PCLK2Config(RCC_HCLK_Div1);
        RCC_PCLK1Config(RCC_HCLK_Div2);
        RCC_PLLConfig(RCC_PLLSource_HSE_Div1, RCC_PLLMul_6);//8M时为9，12M时为6.
        RCC_PLLCmd(ENABLE);
        while(RCC_GetFlagStatus(RCC_FLAG_PLLRDY)==RESET)
        {
        ;
        }
        RCC_SYSCLKConfig(RCC_SYSCLKSource_PLLCLK);
        while(RCC_GetSYSCLKSource()==!0x08)
        {
        ;
        }
    }
} 
/*********************************************************************************************************
** 函数名称: Delay
** 功能描述: 延时程序。
** 输  　入: time 要延时的程序。
** 输　  出: 无
** 全局变量: 无
** 调用模块: 无
** 返    回：无
** 作  　者: 李正星
** 日　  期: 2011年7月18日
**------------------------------------------------------------------------------------------------------
** 修 改 人:
** 日　  期:
**------------------------------------------------------------------------------------------------------
*********************************************************************************************************/
void Delay(unsigned short time)
{
    unsigned short i, j;
    for(;time>0; time--)
    {
        for(j=0; j<10; j++)
        {
            for(i=0; i<1000; i++);
        }
    }
}
/*********************************************************************************************************
** 函数名称: main函数
** 功能描述: 程序的开端。
** 输  　入: 无。
** 输　  出: 无
** 全局变量: 无
** 调用模块: 无
** 返    回：无
** 作  　者: 李正星
** 日　  期: 2011年7月18日
**------------------------------------------------------------------------------------------------------
** 修 改 人:
** 日　  期:
**------------------------------------------------------------------------------------------------------
*********************************************************************************************************/
int main(void)
{
    //u8t i;
    u8t len=20;
	u8t textStr[]={0x4e,0x0a,0x6d,0x77,0x82,0x7e,0x5b,0x89,0x75,0x35,0x5b,0x50,0x67,0x09,0x96,0x50,0x51,0x6c,0x53,0xf8};
    SysClock_Init();
    RCC_Configuration();
    GPIO_Configuration();
    NVIC_Configuration();
 //   LED_ONOFF(0);
//    USART1_Printf("Hello, welcome to use LED Display!");
	LED_ONOFF(1);
    while(1)
    {
		//LedDisplay(textStr, len, 0, STYLE_RIGHT_TO_LEFT);
	   //Dis_Static(textStr,len);
	   //Dis_RightToLeft(textStr,len);
	   Dis_BottomToTop(textStr,len);
	}
}

